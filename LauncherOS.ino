// ============================================================================
//  LauncherOS.ino   --   DualCore Watch launcher (LVGL 8.3 / 8.4)
//  ----------------------------------------------------------------------------
//  Permanent launcher firmware for the Waveshare ESP32-S3-Touch-AMOLED-2.06.
//  Lives in the `factory` partition.  Built against LVGL v8 (NOT v9).
//
//  Single file as requested.  Everything (pin map, splash, watch face,
//  selector, OTA loader) lives in this .ino.  Drop `partitions.csv`
//  next to it before flashing.
//
//  Required libraries (Arduino IDE):
//      - Arduino_GFX_Library             (Waveshare bundle)
//      - Arduino_DriveBus_Library        (Waveshare bundle)
//      - SensorLib  +  XPowersLib        (Waveshare bundle)
//      - LVGL  v8.3.x  /  8.4
//      - Preferences  (built-in)
//      - WiFi         (built-in)
//
//  Optional custom font:  see USE_CUSTOM_FONT below.
// ============================================================================

#include <Arduino.h>
#include <FS.h>
#include <SD_MMC.h>
#include <Wire.h>
#include <WiFi.h>
#include <Preferences.h>
#include <time.h>
#include <memory>

#include "Arduino_GFX_Library.h"
#include "Arduino_DriveBus_Library.h"
#include "lv_conf.h"
#include "lvgl.h"
#include "XPowersLib.h"

#include <esp_ota_ops.h>
#include <esp_partition.h>
#include <esp_image_format.h>
#include <esp_system.h>

#include "HWCDC.h"
HWCDC USBSerial;

// ============================================================================
//  CUSTOM FONT TOGGLE
//  Drop a font generated by https://lvgl.io/tools/fontconverter (v8) next
//  to this .ino, then flip this on.  Recommended: Oswald @ 72 px, BPP=4,
//  range 0x30-0x3A.
// ============================================================================
#define USE_CUSTOM_FONT  0

#if USE_CUSTOM_FONT
    // The .c file from the converter declares the font as:
    //     const lv_font_t oswald_72;
    // ...and we include it via the build (just drop the .c next to the .ino).
    extern const lv_font_t oswald_72;
    #define FACE_TIME_FONT  oswald_72
#else
    #define FACE_TIME_FONT  lv_font_montserrat_48
#endif

// ============================================================================
//  PIN MAP -- from Waveshare Mylibrary/pin_config.h (verbatim)
// ============================================================================
#define LCD_SDIO0   4
#define LCD_SDIO1   5
#define LCD_SDIO2   6
#define LCD_SDIO3   7
#define LCD_SCLK   11
#define LCD_CS     12
#define LCD_RESET   8
#define LCD_WIDTH  410
#define LCD_HEIGHT 502

#define IIC_SDA    15
#define IIC_SCL    14
#define TP_INT     38
#define TP_RESET    9

static const int SDMMC_CLK  = 2;
static const int SDMMC_CMD  = 1;
static const int SDMMC_DATA = 3;

#define SCREEN_OFF_TIMEOUT_MS  3000

// ---- hardcoded WiFi fallback (matches S3_MiniOS_206) ----------------------
static const char *HC_WIFI_SSID = "Optus_9D2E3D";
static const char *HC_WIFI_PASS = "snucktemptGLeQU";

// ============================================================================
//  Display / touch / LVGL globals  (v8 driver pattern)
// ============================================================================
Arduino_DataBus *bus = new Arduino_ESP32QSPI(
    LCD_CS, LCD_SCLK, LCD_SDIO0, LCD_SDIO1, LCD_SDIO2, LCD_SDIO3);

Arduino_GFX *gfx = new Arduino_CO5300(
    bus, LCD_RESET, 0 /*rot*/, LCD_WIDTH, LCD_HEIGHT, 22, 0, 0, 0);

std::shared_ptr<Arduino_IIC_DriveBus> IIC_Bus =
    std::make_shared<Arduino_HWIIC>(IIC_SDA, IIC_SCL, &Wire);

void Arduino_IIC_Touch_Interrupt(void);

std::unique_ptr<Arduino_IIC> FT3168(new Arduino_FT3x68(
    IIC_Bus, FT3168_DEVICE_ADDRESS, DRIVEBUS_DEFAULT_VALUE,
    TP_INT, Arduino_IIC_Touch_Interrupt));

void Arduino_IIC_Touch_Interrupt(void) { FT3168->IIC_Interrupt_Flag = true; }

// ---- LVGL v8 display buffer + driver ----
static lv_disp_draw_buf_t draw_buf;
static lv_color_t        *lvgl_buf = nullptr;
static lv_disp_drv_t      disp_drv;
static lv_indev_drv_t     indev_drv;

static uint32_t lastTouchMs = 0;
static bool     screenIsOff = false;

static void my_disp_flush(lv_disp_drv_t *drv, const lv_area_t *area,
                          lv_color_t *color_p) {
    uint32_t w = lv_area_get_width(area);
    uint32_t h = lv_area_get_height(area);
    gfx->draw16bitRGBBitmap(area->x1, area->y1,
                            (uint16_t *)&color_p->full, w, h);
    lv_disp_flush_ready(drv);
}

static void my_touchpad_read(lv_indev_drv_t *drv, lv_indev_data_t *data) {
    int32_t x = FT3168->IIC_Read_Device_Value(
        FT3168->Arduino_IIC_Touch::Value_Information::TOUCH_COORDINATE_X);
    int32_t y = FT3168->IIC_Read_Device_Value(
        FT3168->Arduino_IIC_Touch::Value_Information::TOUCH_COORDINATE_Y);
    if (FT3168->IIC_Interrupt_Flag) {
        FT3168->IIC_Interrupt_Flag = false;
        data->state   = LV_INDEV_STATE_PR;
        data->point.x = x;
        data->point.y = y;
        lastTouchMs = millis();
    } else {
        data->state = LV_INDEV_STATE_REL;
    }
}

// CO5300 wants 2-pixel-aligned regions.
static void rounder_event_cb(lv_disp_drv_t *drv, lv_area_t *area) {
    area->x1 = (area->x1 >> 1) << 1;
    area->y1 = (area->y1 >> 1) << 1;
    area->x2 = ((area->x2 >> 1) << 1) + 1;
    area->y2 = ((area->y2 >> 1) << 1) + 1;
}

// ============================================================================
//  AXP2101 PMU
// ============================================================================
XPowersPMU g_pmu;
static bool g_has_pmu = false;
static int  g_batt_pct = -1;
static bool g_charging = false;

static void pmu_init() {
    if (g_pmu.begin(Wire, AXP2101_SLAVE_ADDRESS, IIC_SDA, IIC_SCL)) {
        g_has_pmu = true;
        g_pmu.disableTSPinMeasure();
        g_pmu.enableBattVoltageMeasure();
        USBSerial.println("[pmu] AXP2101 ok");
    }
}
static void pmu_refresh() {
    if (!g_has_pmu) return;
    g_batt_pct = g_pmu.getBatteryPercent();
    g_charging = g_pmu.isCharging();
}

// ============================================================================
//  WiFi / NTP — /WATCH/wifi/config.txt
// ============================================================================
struct WifiNet { String ssid, pass; };
static WifiNet g_nets[5];
static int     g_net_count = 0;
static int     g_gmt_offset_sec = 0;
static bool    g_wifi_connected = false;
static bool    g_ntp_synced     = false;

static void parse_wifi_config() {
    File f = SD_MMC.open("/WATCH/wifi/config.txt", FILE_READ);
    if (!f) return;
    while (f.available()) {
        String line = f.readStringUntil('\n');
        line.trim();
        if (line.length() == 0 || line.startsWith("#")) continue;
        int eq = line.indexOf('=');
        if (eq < 0) continue;
        String key = line.substring(0, eq);
        String val = line.substring(eq + 1);
        key.trim(); val.trim();
        for (int i = 1; i <= 5; i++) {
            if (key == String("WIFI") + i + "_SSID" && val.length() &&
                val != "YourHomeNetwork" && val != "YourWorkNetwork") {
                if (g_net_count < 5) g_nets[g_net_count].ssid = val;
            }
            if (key == String("WIFI") + i + "_PASS" && val.length()) {
                int idx = g_net_count;
                if (idx < 5 && g_nets[idx].ssid.length() &&
                    g_nets[idx].pass.length() == 0) {
                    g_nets[idx].pass = val;
                    g_net_count++;
                }
            }
        }
        if (key == "GMT_OFFSET") g_gmt_offset_sec = val.toInt() * 3600;
    }
    f.close();
}

static void wifi_connect_and_sync() {
    WiFi.mode(WIFI_STA);
    for (int i = 0; i < g_net_count && !g_wifi_connected; i++) {
        WiFi.begin(g_nets[i].ssid.c_str(), g_nets[i].pass.c_str());
        uint32_t u = millis() + 6000;
        while (millis() < u && WiFi.status() != WL_CONNECTED) delay(100);
        g_wifi_connected = (WiFi.status() == WL_CONNECTED);
    }
    if (!g_wifi_connected) {
        WiFi.begin(HC_WIFI_SSID, HC_WIFI_PASS);
        uint32_t u = millis() + 6000;
        while (millis() < u && WiFi.status() != WL_CONNECTED) delay(100);
        g_wifi_connected = (WiFi.status() == WL_CONNECTED);
    }
    if (g_wifi_connected) {
        configTime(g_gmt_offset_sec, 0, "pool.ntp.org");
        struct tm tm;
        for (int i = 0; i < 30 && !g_ntp_synced; i++)
            if (getLocalTime(&tm, 200)) g_ntp_synced = true;
    }
}

// ============================================================================
//  Favourites (NVS-backed)
// ============================================================================
Preferences g_prefs;
#define MAX_FAVS 16
static String g_favs[MAX_FAVS];
static int    g_fav_count = 0;

static void favs_load() {
    g_fav_count = 0;
    g_prefs.begin("dcw", true);
    String csv = g_prefs.getString("favs", "");
    g_prefs.end();
    int from = 0;
    while (from < (int)csv.length() && g_fav_count < MAX_FAVS) {
        int c = csv.indexOf(',', from);
        if (c < 0) c = csv.length();
        String item = csv.substring(from, c); item.trim();
        if (item.length()) g_favs[g_fav_count++] = item;
        from = c + 1;
    }
}
static void favs_save() {
    String csv;
    for (int i = 0; i < g_fav_count; i++) { if (i) csv += ","; csv += g_favs[i]; }
    g_prefs.begin("dcw", false);
    g_prefs.putString("favs", csv);
    g_prefs.end();
}
static bool favs_contains(const String &n){for(int i=0;i<g_fav_count;i++)if(g_favs[i]==n)return true;return false;}
static void favs_toggle(const String &n) {
    for (int i = 0; i < g_fav_count; i++) if (g_favs[i] == n) {
        for (int j = i; j < g_fav_count-1; j++) g_favs[j] = g_favs[j+1];
        g_fav_count--; favs_save(); return;
    }
    if (g_fav_count < MAX_FAVS) { g_favs[g_fav_count++] = n; favs_save(); }
}

// ============================================================================
//  ============      "DualCore Watch" animated boot splash         ============
// ============================================================================
static lv_obj_t *splash_screen = nullptr;
static lv_obj_t *splash_status = nullptr;
static lv_obj_t *splash_bar    = nullptr;

static void anim_arc(void *v, int32_t x){lv_arc_set_value((lv_obj_t*)v,x);}
static void anim_rot(void *v, int32_t x){lv_arc_set_rotation((lv_obj_t*)v,(uint16_t)(x%360));}
static void anim_opa(void *v, int32_t x){lv_obj_set_style_text_opa((lv_obj_t*)v,x,0);}

static lv_obj_t *make_arc(lv_obj_t *par, int size, lv_color_t col, int w) {
    lv_obj_t *a = lv_arc_create(par);
    lv_obj_set_size(a, size, size);
    lv_obj_align(a, LV_ALIGN_CENTER, 0, -40);
    lv_arc_set_bg_angles(a, 0, 360);
    lv_obj_remove_style(a, NULL, LV_PART_KNOB);
    lv_obj_set_style_arc_color(a, lv_color_hex(0x101010), LV_PART_MAIN);
    lv_obj_set_style_arc_width(a, w, LV_PART_MAIN);
    lv_obj_set_style_arc_color(a, col, LV_PART_INDICATOR);
    lv_obj_set_style_arc_width(a, w, LV_PART_INDICATOR);
    lv_arc_set_value(a, 0);
    return a;
}
static void pulse_arc(lv_obj_t *a, uint32_t period, int dir) {
    lv_anim_t an; lv_anim_init(&an); lv_anim_set_var(&an, a);
    lv_anim_set_exec_cb(&an, anim_arc);
    lv_anim_set_values(&an, 0, 100);
    lv_anim_set_time(&an, period);
    lv_anim_set_playback_time(&an, period);
    lv_anim_set_repeat_count(&an, LV_ANIM_REPEAT_INFINITE);
    lv_anim_set_path_cb(&an, lv_anim_path_ease_in_out);
    lv_anim_start(&an);

    lv_anim_t r; lv_anim_init(&r); lv_anim_set_var(&r, a);
    lv_anim_set_exec_cb(&r, anim_rot);
    lv_anim_set_values(&r, 0, 360 * dir);
    lv_anim_set_time(&r, period * 4);
    lv_anim_set_repeat_count(&r, LV_ANIM_REPEAT_INFINITE);
    lv_anim_start(&r);
}

static void build_splash() {
    splash_screen = lv_obj_create(NULL);
    lv_obj_set_style_bg_color(splash_screen, lv_color_hex(0x000000), 0);
    lv_obj_set_style_bg_opa(splash_screen, LV_OPA_COVER, 0);
    lv_scr_load(splash_screen);

    pulse_arc(make_arc(splash_screen, 280, lv_color_hex(0x00E5FF), 6), 1400,  1);
    pulse_arc(make_arc(splash_screen, 220, lv_color_hex(0xFF2BD6), 5), 1100, -1);
    pulse_arc(make_arc(splash_screen, 160, lv_color_hex(0xFFB300), 4),  850,  1);

    lv_obj_t *t1 = lv_label_create(splash_screen);
    lv_label_set_text(t1, "DualCore");
    lv_obj_set_style_text_color(t1, lv_color_hex(0xFFFFFF), 0);
    lv_obj_set_style_text_font(t1, &lv_font_montserrat_28, 0);
    lv_obj_align(t1, LV_ALIGN_CENTER, 0, 60);

    lv_obj_t *t2 = lv_label_create(splash_screen);
    lv_label_set_text(t2, "W A T C H");
    lv_obj_set_style_text_color(t2, lv_color_hex(0x00E5FF), 0);
    lv_obj_set_style_text_font(t2, &lv_font_montserrat_18, 0);
    lv_obj_set_style_text_letter_space(t2, 6, 0);
    lv_obj_align(t2, LV_ALIGN_CENTER, 0, 100);

    auto fade = [](lv_obj_t *o, uint32_t d){
        lv_obj_set_style_text_opa(o, 0, 0);
        lv_anim_t a; lv_anim_init(&a); lv_anim_set_var(&a, o);
        lv_anim_set_exec_cb(&a, anim_opa);
        lv_anim_set_values(&a, 0, 255);
        lv_anim_set_time(&a, 900);
        lv_anim_set_delay(&a, d);
        lv_anim_start(&a);
    };
    fade(t1, 100); fade(t2, 500);

    splash_bar = lv_bar_create(splash_screen);
    lv_obj_set_size(splash_bar, 240, 4);
    lv_obj_align(splash_bar, LV_ALIGN_BOTTOM_MID, 0, -60);
    lv_obj_set_style_bg_color(splash_bar, lv_color_hex(0x111111), LV_PART_MAIN);
    lv_obj_set_style_bg_color(splash_bar, lv_color_hex(0x00E5FF), LV_PART_INDICATOR);
    lv_bar_set_range(splash_bar, 0, 100);

    splash_status = lv_label_create(splash_screen);
    lv_label_set_text(splash_status, "booting...");
    lv_obj_set_style_text_color(splash_status, lv_color_hex(0x7BEF7B), 0);
    lv_obj_set_style_text_font(splash_status, &lv_font_montserrat_14, 0);
    lv_obj_align(splash_status, LV_ALIGN_BOTTOM_MID, 0, -30);
}

static void lvgl_pump();   // forward decl
static void splash_progress(int pct, const char *msg) {
    if (!splash_bar) return;
    lv_bar_set_value(splash_bar, pct, LV_ANIM_ON);
    lv_label_set_text(splash_status, msg);
    uint32_t until = millis() + 250;
    while (millis() < until) { lvgl_pump(); delay(5); }
}

// ============================================================================
//  Wallpaper loader  -- /WATCH/PHOTOS/*.raw or *.bin (RGB565 LE, 410x502)
// ============================================================================
#define MAX_PHOTOS 24
static String g_photos[MAX_PHOTOS];
static int    g_photo_count = 0;
static int    g_photo_idx   = 0;

static lv_img_dsc_t g_face_img_dsc = { };
static uint8_t     *g_face_pixels  = nullptr;
static size_t       g_face_alloc   = 0;

static void scan_photos() {
    g_photo_count = 0;
    File dir = SD_MMC.open("/WATCH/PHOTOS");
    if (!dir || !dir.isDirectory()) return;
    File f = dir.openNextFile();
    while (f && g_photo_count < MAX_PHOTOS) {
        if (!f.isDirectory()) {
            String n = f.name();
            int s = n.lastIndexOf('/'); if (s >= 0) n = n.substring(s + 1);
            String lo = n; lo.toLowerCase();
            if (lo.endsWith(".raw") || lo.endsWith(".bin")) {
                g_photos[g_photo_count++] = String("/WATCH/PHOTOS/") + n;
            }
        }
        f = dir.openNextFile();
    }
}

static bool load_photo(int idx) {
    if (g_photo_count == 0) return false;
    if (idx < 0) idx = g_photo_count - 1;
    if (idx >= g_photo_count) idx = 0;

    File f = SD_MMC.open(g_photos[idx].c_str(), FILE_READ);
    if (!f) return false;
    size_t need = (size_t)LCD_WIDTH * LCD_HEIGHT * 2;
    if (!g_face_pixels || g_face_alloc < need) {
        if (g_face_pixels) heap_caps_free(g_face_pixels);
        g_face_pixels = (uint8_t *)heap_caps_malloc(need, MALLOC_CAP_SPIRAM|MALLOC_CAP_8BIT);
        if (!g_face_pixels) g_face_pixels = (uint8_t *)heap_caps_malloc(need, MALLOC_CAP_8BIT);
        if (!g_face_pixels) { f.close(); return false; }
        g_face_alloc = need;
    }
    memset(g_face_pixels, 0, need);
    size_t fsize = f.size();
    f.read(g_face_pixels, fsize < need ? fsize : need);
    f.close();

    g_face_img_dsc.header.cf          = LV_IMG_CF_TRUE_COLOR;
    g_face_img_dsc.header.always_zero = 0;
    g_face_img_dsc.header.w           = LCD_WIDTH;
    g_face_img_dsc.header.h           = LCD_HEIGHT;
    g_face_img_dsc.data_size          = need;
    g_face_img_dsc.data               = g_face_pixels;

    g_photo_idx = idx;
    return true;
}

// ============================================================================
//  ============   MAIN UI   --   Tileview  [ watch face | selector ]   ========
// ============================================================================
static lv_obj_t *main_screen = nullptr;
static lv_obj_t *tileview    = nullptr;
static lv_obj_t *tile_face   = nullptr;
static lv_obj_t *tile_list   = nullptr;

// ---- watch-face widgets ---------------------------------------------------
static lv_obj_t *face_bg_img    = nullptr;
static lv_obj_t *face_bg_fill   = nullptr;
static lv_obj_t *face_time      = nullptr;
static lv_obj_t *face_date      = nullptr;
static lv_obj_t *face_batt_lbl  = nullptr;
static lv_obj_t *face_batt_icon = nullptr;
static lv_obj_t *face_batt_fill = nullptr;
static lv_obj_t *face_batt_bolt = nullptr;
static lv_obj_t *face_status    = nullptr;

static void refresh_wallpaper() {
    if (g_photo_count == 0) {
        if (face_bg_img)  lv_obj_add_flag(face_bg_img, LV_OBJ_FLAG_HIDDEN);
        if (face_bg_fill) lv_obj_clear_flag(face_bg_fill, LV_OBJ_FLAG_HIDDEN);
        return;
    }
    if (!load_photo(g_photo_idx)) return;
    if (face_bg_fill) lv_obj_add_flag(face_bg_fill, LV_OBJ_FLAG_HIDDEN);
    lv_obj_clear_flag(face_bg_img, LV_OBJ_FLAG_HIDDEN);
    lv_img_set_src(face_bg_img, &g_face_img_dsc);
    lv_obj_invalidate(face_bg_img);
}

static void face_tap_cb(lv_event_t *e) {
    if (lv_event_get_code(e) != LV_EVENT_CLICKED) return;
    if (g_photo_count == 0) return;
    g_photo_idx = (g_photo_idx + 1) % g_photo_count;
    refresh_wallpaper();
}

static void update_face_time() {
    if (!face_time) return;
    struct tm tm;
    if (g_ntp_synced && getLocalTime(&tm, 5)) {
        char hm[8], dt[32];
        strftime(hm, sizeof(hm), "%H:%M", &tm);
        strftime(dt, sizeof(dt), "%a  %d %b", &tm);
        lv_label_set_text(face_time, hm);
        lv_label_set_text(face_date, dt);
    } else {
        lv_label_set_text(face_time, "18:15");           // visible placeholder
        lv_label_set_text(face_date, g_wifi_connected ? "syncing..." : "no wifi");
    }
    lv_color_t dot = g_ntp_synced     ? lv_color_hex(0x00FF80)
                   : g_wifi_connected ? lv_color_hex(0xFFB300)
                                      : lv_color_hex(0xFF4040);
    lv_obj_set_style_bg_color(face_status, dot, 0);
}

static void update_face_battery() {
    if (!face_batt_icon) return;
    pmu_refresh();
    if (!g_has_pmu || g_batt_pct < 0) {
        lv_obj_add_flag(face_batt_icon, LV_OBJ_FLAG_HIDDEN);
        lv_obj_add_flag(face_batt_fill, LV_OBJ_FLAG_HIDDEN);
        lv_obj_add_flag(face_batt_bolt, LV_OBJ_FLAG_HIDDEN);
        lv_label_set_text(face_batt_lbl, "");
        return;
    }
    lv_obj_clear_flag(face_batt_icon, LV_OBJ_FLAG_HIDDEN);
    lv_obj_clear_flag(face_batt_fill, LV_OBJ_FLAG_HIDDEN);
    int pct = g_batt_pct; if (pct<0)pct=0; if (pct>100)pct=100;
    int fw = (28 * pct) / 100; if (fw < 1 && pct>0) fw = 1;
    lv_obj_set_width(face_batt_fill, fw);
    lv_color_t col = pct<=15 ? lv_color_hex(0xFF4040)
                   : pct<=30 ? lv_color_hex(0xFFB300)
                             : lv_color_hex(0xFFFFFF);   // white for the photo look
    lv_obj_set_style_bg_color(face_batt_fill, col, 0);
    if (g_charging) lv_obj_clear_flag(face_batt_bolt, LV_OBJ_FLAG_HIDDEN);
    else            lv_obj_add_flag(face_batt_bolt, LV_OBJ_FLAG_HIDDEN);
    char b[8]; snprintf(b, 8, "%d%%", pct);
    lv_label_set_text(face_batt_lbl, b);
}

// ---- WATCH FACE (matches the reference photo) ------------------------------
//  Layout, top → bottom on a 410×502 portrait screen:
//
//      [batt]                                    [dot]   <- tiny chrome,
//                                                          opa ≈ 140
//
//                    18 : 15                              <- HUGE time,
//                                                          translucent white
//                                                          opa ≈ 220
//                    Tue  04 Feb                          <- small subtitle,
//                                                          opa ≈ 160
//
//      ▒▒▒▒▒▒▒▒  full-bleed mountain wallpaper  ▒▒▒▒▒▒▒▒
//      ▒▒▒▒▒▒▒▒                                 ▒▒▒▒▒▒▒▒
// ----------------------------------------------------------------------------
static void build_tile_face(lv_obj_t *parent) {
    tile_face = lv_tileview_add_tile(parent, 0, 0, LV_DIR_RIGHT);
    lv_obj_set_style_bg_color(tile_face, lv_color_hex(0x000000), 0);
    lv_obj_set_style_bg_opa(tile_face, LV_OPA_COVER, 0);
    lv_obj_clear_flag(tile_face, LV_OBJ_FLAG_SCROLLABLE);
    lv_obj_set_style_pad_all(tile_face, 0, 0);

    // -- fallback gradient when no photos on SD --
    face_bg_fill = lv_obj_create(tile_face);
    lv_obj_set_size(face_bg_fill, LCD_WIDTH, LCD_HEIGHT);
    lv_obj_align(face_bg_fill, LV_ALIGN_TOP_LEFT, 0, 0);
    lv_obj_set_style_radius(face_bg_fill, 0, 0);
    lv_obj_set_style_border_width(face_bg_fill, 0, 0);
    lv_obj_set_style_bg_color(face_bg_fill,      lv_color_hex(0x05060A), 0);
    lv_obj_set_style_bg_grad_color(face_bg_fill, lv_color_hex(0x0A1A2A), 0);
    lv_obj_set_style_bg_grad_dir(face_bg_fill,   LV_GRAD_DIR_VER, 0);
    lv_obj_clear_flag(face_bg_fill, LV_OBJ_FLAG_SCROLLABLE);
    lv_obj_clear_flag(face_bg_fill, LV_OBJ_FLAG_CLICKABLE);

    // -- full-bleed photo wallpaper --
    face_bg_img = lv_img_create(tile_face);
    lv_obj_align(face_bg_img, LV_ALIGN_TOP_LEFT, 0, 0);
    lv_obj_add_flag(face_bg_img, LV_OBJ_FLAG_HIDDEN);

    // -- tap-overlay (transparent, covers the lower 3/4 of the face so the
    //    top chrome stays interactive on the OS itself).  Cycles photos. --
    lv_obj_t *tap = lv_obj_create(tile_face);
    lv_obj_set_size(tap, LCD_WIDTH, LCD_HEIGHT - 70);
    lv_obj_align(tap, LV_ALIGN_BOTTOM_MID, 0, 0);
    lv_obj_set_style_bg_opa(tap, LV_OPA_TRANSP, 0);
    lv_obj_set_style_border_width(tap, 0, 0);
    lv_obj_add_flag(tap, LV_OBJ_FLAG_CLICKABLE);
    lv_obj_clear_flag(tap, LV_OBJ_FLAG_SCROLLABLE);
    lv_obj_add_event_cb(tap, face_tap_cb, LV_EVENT_CLICKED, NULL);

    // -------- BIG TRANSLUCENT TIME (matches reference photo) --------
    face_time = lv_label_create(tile_face);
    lv_label_set_text(face_time, "18:15");
    lv_obj_set_style_text_color(face_time, lv_color_hex(0xFFFFFF), 0);
    lv_obj_set_style_text_font(face_time, &FACE_TIME_FONT, 0);
    lv_obj_set_style_text_opa(face_time, 220, 0);              // translucent
    lv_obj_set_style_text_letter_space(face_time, 2, 0);
    lv_obj_align(face_time, LV_ALIGN_TOP_MID, 0, 60);

    // Subtle outline for legibility on bright backgrounds: a faint dark
    // shadow drawn behind via a duplicate label.
    lv_obj_t *time_shadow = lv_label_create(tile_face);
    lv_label_set_text(time_shadow, "18:15");
    lv_obj_set_style_text_color(time_shadow, lv_color_hex(0x000000), 0);
    lv_obj_set_style_text_font(time_shadow, &FACE_TIME_FONT, 0);
    lv_obj_set_style_text_opa(time_shadow, 90, 0);
    lv_obj_set_style_text_letter_space(time_shadow, 2, 0);
    lv_obj_align(time_shadow, LV_ALIGN_TOP_MID, 2, 62);
    lv_obj_move_background(time_shadow);

    // Hack so the shadow text always mirrors the live time label.
    lv_obj_add_event_cb(face_time,
        [](lv_event_t *e){
            lv_obj_t *t = (lv_obj_t *)lv_event_get_target(e);
            lv_obj_t *sh = (lv_obj_t *)lv_event_get_user_data(e);
            lv_label_set_text(sh, lv_label_get_text(t));
        }, LV_EVENT_REFRESH, time_shadow);

    // Small subtitle date.
    face_date = lv_label_create(tile_face);
    lv_label_set_text(face_date, "");
    lv_obj_set_style_text_color(face_date, lv_color_hex(0xFFFFFF), 0);
    lv_obj_set_style_text_font(face_date, &lv_font_montserrat_18, 0);
    lv_obj_set_style_text_opa(face_date, 160, 0);
    lv_obj_align(face_date, LV_ALIGN_TOP_MID, 0, 145);

    // ---- battery indicator (top-left) ----------------------------------
    face_batt_icon = lv_obj_create(tile_face);
    lv_obj_set_size(face_batt_icon, 32, 14);
    lv_obj_align(face_batt_icon, LV_ALIGN_TOP_LEFT, 18, 18);
    lv_obj_set_style_radius(face_batt_icon, 3, 0);
    lv_obj_set_style_border_color(face_batt_icon, lv_color_hex(0xFFFFFF), 0);
    lv_obj_set_style_border_width(face_batt_icon, 1, 0);
    lv_obj_set_style_border_opa(face_batt_icon, 180, 0);
    lv_obj_set_style_bg_opa(face_batt_icon, LV_OPA_TRANSP, 0);
    lv_obj_clear_flag(face_batt_icon, LV_OBJ_FLAG_SCROLLABLE);
    lv_obj_clear_flag(face_batt_icon, LV_OBJ_FLAG_CLICKABLE);

    face_batt_fill = lv_obj_create(face_batt_icon);
    lv_obj_set_size(face_batt_fill, 0, 10);
    lv_obj_align(face_batt_fill, LV_ALIGN_LEFT_MID, 1, 0);
    lv_obj_set_style_radius(face_batt_fill, 2, 0);
    lv_obj_set_style_border_width(face_batt_fill, 0, 0);
    lv_obj_set_style_bg_color(face_batt_fill, lv_color_hex(0xFFFFFF), 0);
    lv_obj_set_style_bg_opa(face_batt_fill, 200, 0);

    face_batt_bolt = lv_label_create(tile_face);
    lv_label_set_text(face_batt_bolt, LV_SYMBOL_CHARGE);
    lv_obj_set_style_text_color(face_batt_bolt, lv_color_hex(0xFFFFFF), 0);
    lv_obj_set_style_text_font(face_batt_bolt, &lv_font_montserrat_14, 0);
    lv_obj_align_to(face_batt_bolt, face_batt_icon, LV_ALIGN_CENTER, 0, 0);
    lv_obj_add_flag(face_batt_bolt, LV_OBJ_FLAG_HIDDEN);

    face_batt_lbl = lv_label_create(tile_face);
    lv_label_set_text(face_batt_lbl, "");
    lv_obj_set_style_text_color(face_batt_lbl, lv_color_hex(0xFFFFFF), 0);
    lv_obj_set_style_text_font(face_batt_lbl, &lv_font_montserrat_14, 0);
    lv_obj_set_style_text_opa(face_batt_lbl, 180, 0);
    lv_obj_align_to(face_batt_lbl, face_batt_icon, LV_ALIGN_OUT_RIGHT_MID, 8, 0);

    // Tiny status dot (top-right).
    face_status = lv_obj_create(tile_face);
    lv_obj_set_size(face_status, 10, 10);
    lv_obj_align(face_status, LV_ALIGN_TOP_RIGHT, -20, 22);
    lv_obj_set_style_radius(face_status, 5, 0);
    lv_obj_set_style_border_width(face_status, 0, 0);
    lv_obj_set_style_bg_color(face_status, lv_color_hex(0xFF4040), 0);
    lv_obj_set_style_bg_opa(face_status, 200, 0);

    refresh_wallpaper();
    update_face_time();
    update_face_battery();
}

// ============================================================================
//  App selector tile  --  /WATCH/bin/*.bin
// ============================================================================
struct AppEntry { String name, path; size_t size; };
#define MAX_APPS 32
static AppEntry  g_apps[MAX_APPS];
static int       g_app_count = 0;

static lv_obj_t *g_list_widget = nullptr;
static bool      load_app_from_sd(const AppEntry &app);
static void      populate_app_list();

// ---- OTA progress overlay -------------------------------------------------
static lv_obj_t *copy_screen=nullptr,*copy_bar=nullptr,*copy_title=nullptr,*copy_pct=nullptr;

static void build_copy_screen(const String &n) {
    copy_screen = lv_obj_create(NULL);
    lv_obj_set_style_bg_color(copy_screen, lv_color_hex(0x000000), 0);
    lv_obj_set_style_bg_opa(copy_screen, LV_OPA_COVER, 0);
    copy_title = lv_label_create(copy_screen);
    lv_label_set_text_fmt(copy_title, "Loading\n%s", n.c_str());
    lv_obj_set_style_text_align(copy_title, LV_TEXT_ALIGN_CENTER, 0);
    lv_obj_set_style_text_color(copy_title, lv_color_hex(0xFFFFFF), 0);
    lv_obj_set_style_text_font(copy_title, &lv_font_montserrat_22, 0);
    lv_obj_align(copy_title, LV_ALIGN_CENTER, 0, -60);
    copy_bar = lv_bar_create(copy_screen);
    lv_obj_set_size(copy_bar, 280, 10);
    lv_obj_align(copy_bar, LV_ALIGN_CENTER, 0, 20);
    lv_obj_set_style_bg_color(copy_bar, lv_color_hex(0x141414), LV_PART_MAIN);
    lv_obj_set_style_bg_color(copy_bar, lv_color_hex(0x00E5FF), LV_PART_INDICATOR);
    lv_bar_set_range(copy_bar, 0, 100);
    copy_pct = lv_label_create(copy_screen);
    lv_label_set_text(copy_pct, "0%");
    lv_obj_set_style_text_color(copy_pct, lv_color_hex(0x00E5FF), 0);
    lv_obj_set_style_text_font(copy_pct, &lv_font_montserrat_18, 0);
    lv_obj_align(copy_pct, LV_ALIGN_CENTER, 0, 60);
    lv_scr_load(copy_screen);
    lvgl_pump();
}
static void copy_progress(int p){lv_bar_set_value(copy_bar,p,LV_ANIM_OFF);char b[8];snprintf(b,8,"%d%%",p);lv_label_set_text(copy_pct,b);lvgl_pump();}
static void copy_error(const String&m){lv_label_set_text_fmt(copy_title,"ERROR\n%s",m.c_str());lv_obj_set_style_text_color(copy_title,lv_color_hex(0xFF4040),0);lvgl_pump();}

static bool load_app_from_sd(const AppEntry &app) {
    build_copy_screen(app.name);
    const esp_partition_t *ota = esp_ota_get_next_update_partition(NULL);
    if (!ota) { copy_error("no ota slot"); return false; }
    File f = SD_MMC.open(app.path.c_str(), FILE_READ);
    if (!f) { copy_error("open failed"); return false; }
    esp_ota_handle_t h;
    if (esp_ota_begin(ota, app.size, &h) != ESP_OK) { copy_error("ota_begin"); f.close(); return false; }
    uint8_t *buf = (uint8_t *)heap_caps_malloc(4096, MALLOC_CAP_8BIT);
    size_t written = 0; int last = -1;
    while (true) {
        int n = f.read(buf, 4096);
        if (n <= 0) break;
        if (esp_ota_write(h, buf, n) != ESP_OK) { free(buf); f.close(); copy_error("ota_write"); return false; }
        written += n;
        int pct = app.size ? (int)((written * 100) / app.size) : 0;
        if (pct != last) { copy_progress(pct); last = pct; }
    }
    free(buf); f.close();
    if (esp_ota_end(h) != ESP_OK)            { copy_error("ota_end");  return false; }
    if (esp_ota_set_boot_partition(ota)!=ESP_OK){ copy_error("set_boot"); return false; }
    copy_progress(100);
    lv_label_set_text(copy_title, "Launching...");
    lv_obj_set_style_text_color(copy_title, lv_color_hex(0x00FF80), 0);
    lvgl_pump();
    delay(600);
    esp_restart();
    return true;
}

static void scan_apps() {
    g_app_count = 0;
    File dir = SD_MMC.open("/WATCH/bin");
    if (!dir || !dir.isDirectory()) return;
    File f = dir.openNextFile();
    while (f && g_app_count < MAX_APPS) {
        if (!f.isDirectory()) {
            String n = f.name();
            int s = n.lastIndexOf('/'); if (s >= 0) n = n.substring(s + 1);
            String lo = n; lo.toLowerCase();
            if (lo.endsWith(".bin")) {
                g_apps[g_app_count].path = String("/WATCH/bin/") + n;
                g_apps[g_app_count].name = n.substring(0, n.length() - 4);
                g_apps[g_app_count].size = f.size();
                g_app_count++;
            }
        }
        f = dir.openNextFile();
    }
}

static void list_event_cb(lv_event_t *e) {
    lv_event_code_t code = lv_event_get_code(e);
    int idx = (int)(intptr_t)lv_event_get_user_data(e);
    if (idx < 0 || idx >= g_app_count) return;
    if (code == LV_EVENT_CLICKED)              load_app_from_sd(g_apps[idx]);
    else if (code == LV_EVENT_LONG_PRESSED)  { favs_toggle(g_apps[idx].name); populate_app_list(); }
}

static void compute_order(int *out) {
    int n = 0;
    for (int i = 0; i < g_fav_count; i++)
        for (int j = 0; j < g_app_count; j++)
            if (g_apps[j].name == g_favs[i]) { out[n++] = j; break; }
    for (int j = 0; j < g_app_count; j++)
        if (!favs_contains(g_apps[j].name)) out[n++] = j;
}

static void populate_app_list() {
    if (!g_list_widget) return;
    lv_obj_clean(g_list_widget);
    if (g_app_count == 0) {
        lv_obj_t *e = lv_label_create(g_list_widget);
        lv_label_set_text(e, "No /WATCH/bin/*.bin found.\n\n"
                             "Drop compiled .bin files in\n/WATCH/bin/.");
        lv_obj_set_style_text_align(e, LV_TEXT_ALIGN_CENTER, 0);
        lv_obj_set_style_text_color(e, lv_color_hex(0xAAAAAA), 0);
        lv_obj_center(e);
        return;
    }
    int order[MAX_APPS]; compute_order(order);
    if (g_fav_count > 0) {
        lv_obj_t *h = lv_label_create(g_list_widget);
        lv_label_set_text(h, LV_SYMBOL_OK "  Favourites");
        lv_obj_set_style_text_color(h, lv_color_hex(0xFFB300), 0);
        lv_obj_set_style_text_font(h, &lv_font_montserrat_14, 0);
        lv_obj_set_style_pad_left(h, 12, 0);
    }
    int shown_favs = 0;
    for (int k = 0; k < g_app_count; k++) {
        int i = order[k];
        bool isFav = favs_contains(g_apps[i].name);
        if (g_fav_count > 0 && shown_favs == g_fav_count && !isFav) {
            lv_obj_t *sep = lv_label_create(g_list_widget);
            lv_label_set_text(sep, "All apps");
            lv_obj_set_style_text_color(sep, lv_color_hex(0x666666), 0);
            lv_obj_set_style_text_font(sep, &lv_font_montserrat_14, 0);
            lv_obj_set_style_pad_left(sep, 12, 0);
            lv_obj_set_style_pad_top(sep, 8, 0);
        }
        if (isFav) shown_favs++;
        char line[96];
        snprintf(line, sizeof(line), "%s    (%.1f KB)",
                 g_apps[i].name.c_str(), g_apps[i].size / 1024.0f);
        lv_obj_t *b = lv_list_add_btn(g_list_widget,
                                      isFav ? LV_SYMBOL_OK : LV_SYMBOL_PLAY, line);
        lv_obj_set_style_bg_color(b, lv_color_hex(isFav ? 0x1A1408 : 0x111111), 0);
        lv_obj_set_style_text_color(b, lv_color_hex(isFav ? 0xFFD060 : 0xFFFFFF), 0);
        lv_obj_set_style_text_font(b, &lv_font_montserrat_16, 0);
        lv_obj_add_event_cb(b, list_event_cb, LV_EVENT_CLICKED,      (void *)(intptr_t)i);
        lv_obj_add_event_cb(b, list_event_cb, LV_EVENT_LONG_PRESSED, (void *)(intptr_t)i);
    }
}

static void build_tile_list(lv_obj_t *parent) {
    tile_list = lv_tileview_add_tile(parent, 1, 0, LV_DIR_LEFT);
    lv_obj_set_style_bg_color(tile_list, lv_color_hex(0x000000), 0);
    lv_obj_set_style_bg_opa(tile_list, LV_OPA_COVER, 0);
    lv_obj_clear_flag(tile_list, LV_OBJ_FLAG_SCROLLABLE);

    lv_obj_t *h1 = lv_label_create(tile_list);
    lv_label_set_text(h1, "Apps");
    lv_obj_set_style_text_color(h1, lv_color_hex(0xFFFFFF), 0);
    lv_obj_set_style_text_font(h1, &lv_font_montserrat_22, 0);
    lv_obj_align(h1, LV_ALIGN_TOP_LEFT, 24, 22);

    lv_obj_t *h2 = lv_label_create(tile_list);
    lv_label_set_text(h2, "/WATCH/bin  (long-press = star)");
    lv_obj_set_style_text_color(h2, lv_color_hex(0x00E5FF), 0);
    lv_obj_set_style_text_font(h2, &lv_font_montserrat_14, 0);
    lv_obj_align(h2, LV_ALIGN_TOP_LEFT, 24, 50);

    g_list_widget = lv_list_create(tile_list);
    lv_obj_set_size(g_list_widget, LCD_WIDTH - 30, LCD_HEIGHT - 110);
    lv_obj_align(g_list_widget, LV_ALIGN_TOP_MID, 0, 80);
    lv_obj_set_style_bg_color(g_list_widget, lv_color_hex(0x080808), 0);
    lv_obj_set_style_border_width(g_list_widget, 0, 0);

    populate_app_list();

    lv_obj_t *foot = lv_label_create(tile_list);
    lv_label_set_text(foot, "swipe " LV_SYMBOL_RIGHT "  watch face");
    lv_obj_set_style_text_color(foot, lv_color_hex(0x555555), 0);
    lv_obj_set_style_text_font(foot, &lv_font_montserrat_12, 0);
    lv_obj_align(foot, LV_ALIGN_BOTTOM_MID, 0, -8);
}

static void build_main_ui() {
    main_screen = lv_obj_create(NULL);
    lv_obj_set_style_bg_color(main_screen, lv_color_hex(0x000000), 0);
    lv_obj_set_style_bg_opa(main_screen, LV_OPA_COVER, 0);
    lv_obj_clear_flag(main_screen, LV_OBJ_FLAG_SCROLLABLE);

    tileview = lv_tileview_create(main_screen);
    lv_obj_set_size(tileview, LCD_WIDTH, LCD_HEIGHT);
    lv_obj_align(tileview, LV_ALIGN_TOP_LEFT, 0, 0);
    lv_obj_set_style_bg_opa(tileview, LV_OPA_COVER, 0);
    lv_obj_set_style_bg_color(tileview, lv_color_hex(0x000000), 0);
    lv_obj_set_scrollbar_mode(tileview, LV_SCROLLBAR_MODE_OFF);

    build_tile_face(tileview);
    build_tile_list(tileview);

    lv_obj_set_tile(tileview, tile_face, LV_ANIM_OFF);
    lv_scr_load_anim(main_screen, LV_SCR_LOAD_ANIM_FADE_ON, 350, 0, true);
}

// ============================================================================
//  Screen-off (AMOLED -> just blank pixels, native sleep behaviour)
// ============================================================================
static void screen_off() {
    if (screenIsOff) return;
    screenIsOff = true;
    gfx->fillScreen(BLACK);
}
static void screen_on() {
    if (!screenIsOff) return;
    screenIsOff = false;
    lv_obj_invalidate(lv_scr_act());
}

// ============================================================================
//  Render pump
// ============================================================================
static void lvgl_pump() { lv_timer_handler(); }

// ============================================================================
//  SETUP
// ============================================================================
void setup() {
    USBSerial.begin(115200);
    USBSerial.println("\n=== LauncherOS (LVGL v8) ===");

    if (!gfx->begin()) USBSerial.println("gfx->begin() failed");
    gfx->fillScreen(BLACK);

    Wire.begin(IIC_SDA, IIC_SCL);
    while (FT3168->begin() == false) { USBSerial.println("FT3168 init fail"); delay(500); }
    FT3168->IIC_Write_Device_State(
        FT3168->Arduino_IIC_Touch::Device::TOUCH_POWER_MODE,
        FT3168->Arduino_IIC_Touch::Device_Mode::TOUCH_POWER_MONITOR);

    pmu_init();
    favs_load();

    // ---- LVGL v8 init ----
    lv_init();

    size_t bufPx = LCD_WIDTH * 60;        // 60-row partial buffer
    lvgl_buf = (lv_color_t *)heap_caps_malloc(bufPx * sizeof(lv_color_t),
                                              MALLOC_CAP_INTERNAL | MALLOC_CAP_8BIT);
    if (!lvgl_buf)
        lvgl_buf = (lv_color_t *)heap_caps_malloc(bufPx * sizeof(lv_color_t), MALLOC_CAP_8BIT);
    lv_disp_draw_buf_init(&draw_buf, lvgl_buf, NULL, bufPx);

    lv_disp_drv_init(&disp_drv);
    disp_drv.flush_cb     = my_disp_flush;
    disp_drv.rounder_cb   = rounder_event_cb;
    disp_drv.draw_buf     = &draw_buf;
    disp_drv.hor_res      = LCD_WIDTH;
    disp_drv.ver_res      = LCD_HEIGHT;
    lv_disp_drv_register(&disp_drv);

    lv_indev_drv_init(&indev_drv);
    indev_drv.type    = LV_INDEV_TYPE_POINTER;
    indev_drv.read_cb = my_touchpad_read;
    lv_indev_drv_register(&indev_drv);

    build_splash();
    splash_progress(10, "init display");

    splash_progress(25, "mounting SD");
    SD_MMC.setPins(SDMMC_CLK, SDMMC_CMD, SDMMC_DATA);
    bool sd_ok = SD_MMC.begin("/sdcard", true);
    if (sd_ok) {
        splash_progress(40, "wifi config");
        parse_wifi_config();
        splash_progress(55, "connecting wifi");
        wifi_connect_and_sync();
        splash_progress(75, "scanning apps");
        scan_apps();
        splash_progress(88, "scanning photos");
        scan_photos();
    } else {
        splash_progress(50, "SD mount failed");
        delay(800);
    }
    splash_progress(100, "ready");
    delay(350);

    build_main_ui();
    lastTouchMs = millis();
}

// ============================================================================
//  LOOP
// ============================================================================
void loop() {
    // LVGL v8 tick (delta-millis approach -- no LV_TICK_CUSTOM required)
    static uint32_t lastMs = 0;
    uint32_t now = millis();
    lv_tick_inc(now - lastMs);
    lastMs = now;

    lvgl_pump();

    // 1 s clock refresh
    static uint32_t tT = 0;
    if (now - tT > 1000) {
        tT = now;
        if (!screenIsOff) {
            update_face_time();
            lv_event_send(face_time, LV_EVENT_REFRESH, NULL);   // sync shadow
        }
    }
    // 3 s battery refresh
    static uint32_t tB = 0;
    if (now - tB > 3000) {
        tB = now;
        if (!screenIsOff) update_face_battery();
    }

    // Screen-off timeout
    if (!screenIsOff && (now - lastTouchMs > SCREEN_OFF_TIMEOUT_MS)) {
        screen_off();
    } else if (screenIsOff && FT3168->IIC_Interrupt_Flag) {
        lastTouchMs = now;
        screen_on();
    }

    delay(5);
}
